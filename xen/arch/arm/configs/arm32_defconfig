## xen/arch/arm/configs/xt_defconfig
```kconfig
CONFIG_XSM=y
CONFIG_TEE=y
CONFIG_OPTEE=y
CONFIG_IPMMU_VMSA=y
CONFIG_IOREQ_SERVER=y
CONFIG_PCI_PASSTHROUGH=y
CONFIG_EXPERT=y
CONFIG_RCAR4=y
```

## xen/arch/arm/coproc/Kconfig
```kconfig
choice
	prompt "GPU virtualization"
	default COPROC_GSX6XX
	depends on HAS_COPROC

	config COPROC_GSX6XX
		bool "Power on/off based"
	config COPROC_GSX_IMG
		bool "Imagination based"
endchoice

config COPROC_XXX
	bool "Reference coproc driver support aka XXX"
	default y
	depends on HAS_COPROC
```

## xen/arch/arm/pci/Kconfig
```kconfig
# SPDX-License-Identifier: GPL-2.0

menu "PCI controller drivers"
	depends on HAS_PCI

config PCIE_XILINX_NWL
	bool "NWL PCIe Core"
	default y
	help
	  Say 'Y' here if you want support for Xilinx NWL PCIe controller.

endmenu
```

## xen/arch/arm/platforms/Kconfig
```kconfig
choice
	prompt "Platform Support"
	default ALL_PLAT
	---help---
	Choose which hardware platform to enable in Xen.

	If unsure, choose ALL_PLAT.

config ALL_PLAT
	bool "All Platforms"
	---help---
	Enable support for all available hardware platforms. It doesn't
	automatically select any of the related drivers.

config QEMU
	bool "QEMU aarch virt machine support"
	depends on ARM_64
	select GICV3
	select HAS_PL011
	---help---
	Enable all the required drivers for QEMU aarch64 virt emulated
	machine.

config RCAR3
	bool "Renesas RCar3 support"
	depends on ARM_64
	select HAS_SCIF
	select IPMMU_VMSA
	---help---
	Enable all the required drivers for Renesas RCar3

config RCAR4
	bool "Renesas RCar4 support"
	depends on ARM_64
	select HAS_SCIF
	select HAS_ITS
	select IPMMU_VMSA
	---help---
	Enable all the required drivers for Renesas RCar4

config MPSOC
	bool "Xilinx Ultrascale+ MPSoC support"
	depends on ARM_64
	select HAS_CADENCE_UART
	select ARM_SMMU
	---help---
	Enable all the required drivers for Xilinx Ultrascale+ MPSoC

config NO_PLAT
	bool "No Platforms"
	---help---
	Do not enable specific support for any platform.

endchoice

config RCAR4_RPROC
       bool "Renesas RPROC pass-through for Gen4"
       depends on RCAR4
	---help---
	Enable experimental RPROC support for RCar4 boards

config ALL64_PLAT
	bool
	default (ALL_PLAT && ARM_64)

config ALL32_PLAT
	bool
	default (ALL_PLAT && ARM_32)

config MPSOC_PLATFORM
	bool
	default (ALL64_PLAT || MPSOC)

config RCAR4_PLATFORM
	bool
	default (ALL64_PLAT || RCAR4)
```

## xen/arch/arm/sci/Kconfig
```kconfig
config SCMI_SMC
	bool "Enable SCMI-SMC mediator driver"
	default n
	depends on ARM_SCI
	help

	Enables mediator in XEN to pass SCMI requests from Domains to ATF.
	This feature allows drivers from Domains to work with System
	Controllers (such as power,resets,clock etc.). SCP is used as transport
	for communication.
```

## xen/drivers/passthrough/Kconfig
```kconfig
config HAS_PASSTHROUGH
	bool

if ARM
config ARM_SMMU
	bool "ARM SMMUv1 and v2 driver"
	default y
	---help---
	  Support for implementations of the ARM System MMU architecture
	  versions 1 and 2.

	  Say Y here if your SoC includes an IOMMU device implementing the
	  ARM SMMU architecture.

config RCAR_IPMMU
	bool "Renesas IPMMU found in RCAR SoCs"
	default y
	---help---
	  Support for implementations of the Renesas IPMMU found in RCAR SoCs.

	  Say Y here if you are using Renesas RCAR SoC.
endif
```
