## xen/arch/arm/tee/Kconfig
```kconfig
menu "TEE mediators"
	visible if UNSUPPORTED

config TEE
	bool
	default n

config OPTEE
	bool "Enable OP-TEE mediator (UNSUPPORTED)" if UNSUPPORTED
	default n
	select TEE
	help
	  Enable the OP-TEE mediator. It allows guests to access
	  OP-TEE running on your platform. This requires
	  virtualization-enabled OP-TEE present. You can learn more
	  about virtualization for OP-TEE at
	  https://optee.readthedocs.io/architecture/virtualization.html

config OPTEE_MAX_SHM_BUFFER_KB
	int "Maximum size of a buffer shared with OP-TEE (KB)" if UNSUPPORTED
	depends on OPTEE
	range 512 8192
	default 512
	help
	  Largest buffer, in KB, that a guest can share with OP-TEE in one
	  call. The Global Platform specification requires at least 512KB.
	  OP-TEE loads a whole TA binary from the normal world through one
	  shared buffer, so this is also the largest TA a guest can load.

	  If unsure, keep the default.

config FFA
	bool "Enable FF-A mediator support (UNSUPPORTED)" if UNSUPPORTED
	default n
	depends on ARM_64
	select TEE
	help
	  This option enables a minimal FF-A mediator. The mediator is
	  generic as it follows the FF-A specification [1], but it only
	  implements a small subset of the specification.

	  [1] https://developer.arm.com/documentation/den0077/latest

config FFA_VM_TO_VM
    bool "Enable FF-A between VMs (UNSUPPORTED)" if UNSUPPORTED
    default n
    depends on FFA
    help
      This option enables to use FF-A between VMs.
      This is experimental and there is no access control so any
      guest can communicate with any other guest.

      If unsure, say N.

endmenu
```
